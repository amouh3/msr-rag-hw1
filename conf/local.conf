## conf/local.conf
```bitbake
app { job = "extract-chunk-smoke" }
# io {
 #  pdfListFile = "E:/msr_data/msr_pdfs.txt"
 #  workDir     = "E:/msr_data/artifacts"
#}
io {
  pdfListFile = "input/pdf_list2.txt"   # your small list in the repo
  workDir     = "out/local"
}

embed {
  model    = "mxbai-embed-large"
  maxChars = 1000
  overlap  = 200
  batch    = 8
}

index {
  out     = "E:/msr_data/artifacts/index.csv"
  maxDocs = 999999
}

search {
  query = "data loss bugs Android" #testing diff queries
  k = 10               # optional: how many results to print
}
mr {
  inputList = "file:///C:/tmp/pdf_list.txt"
  outputDir = "file:///C:/tmp/index_shards"
  shards    = 2
}


# Reducer looks for this; point it at the MR output root so it can create shard dirs under it
msr.output.dir = "file:///C:/tmp/index_shards_mr_out"

stats.outputDir = "out/stats"
stats.topVocab  = 5000   # how many tokens to embed for neighbors
stats.kNN       = 10     # neighbors per token
```
